## algorithm/imu_eda/embedded/mood_gate/Kconfig
```kconfig
config EXAMPLES_MOOD_GATE
	tristate "MoodAnchor IMU + EDA serial gate"
	default n
	depends on ADC
	help
		Compile the on-device MoodAnchor serial inference prototype.
		A low-motion IMU window permits EDA scoring; an EDA-positive window
		confirms an event. The IMU device driver remains board/sensor-specific.

if EXAMPLES_MOOD_GATE

config EXAMPLES_MOOD_GATE_PROGNAME
	string "Program name"
	default "mood_gate"

config EXAMPLES_MOOD_GATE_PRIORITY
	int "Task priority"
	default 100

config EXAMPLES_MOOD_GATE_STACKSIZE
	int "Task stack size"
	default 16384

config EXAMPLES_MOOD_GATE_EDA_ADC_CHANNEL
	int "EDA ADC channel"
	default 0
	help
		ADC channel wired to the external skin-conductance front-end. This is
		not the microphone ADC input.

endif
```

## app/huangshan_hal/Kconfig
```kconfig
config LVX_USE_HUANGSHAN_HAL
	bool "Huangshan Pi hardware interface and demo"
	default n
	depends on ADC && I2C && PWM && LCD && VIDEO_FB && DRIVERS_BLUETOOTH
	select UART_BTH4
	---help---
		Build the reusable SF32LB52 Huangshan Pi hardware interface and the
		`huangshan_hal_demo` NSH command. The official vendor_sifli BSP must
		be selected with the lckfb_huangshan_pi nsh configuration. Enabling
		this option also enables the H:4 pseudo-device required by the BLE
		wrapper (`/dev/ttyHCI0`).

config LVX_USE_DEMO_MOOD_ANCHOR
	bool "MoodAnchor - GSR / heart rate / motion watch application"
	default n
	depends on GRAPHICS_LVGL
	depends on LV_USE_NUTTX
	depends on LVX_USE_HUANGSHAN_HAL
	depends on WIRELESS_BLUETOOTH_HOST
	---help---
		Build the MoodAnchor native application (NSH command `mood_anchor`).
		It runs on the openvela graphics framework (LVGL + lv_nuttx, the
		same path as the official lvgldemo / mini_memo demos) and shows the
		board sensors: skin conductance (GSR) on /dev/adc1, heart rate and
		SpO2 from the MAX30102 on /dev/i2c1, and the LSM6DSL IMU.

		Requires CONFIG_GRAPHICS_LVGL and CONFIG_LV_USE_NUTTX, which the
		official lckfb_huangshan_pi nsh configuration already provides.
```
